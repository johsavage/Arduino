#include <SPI.h> // include the header file for using spi library
#define CHIPSELECT 10//ss
#define SPICLOCK  13//sck
#define DATAOUT 11//MOSI

#define RED	0xE0 // For code readability.
#define GREEN	0x1C // Only 8 colors available
#define BLUE	0x07 // but variation possible with
#define ORANGE  0xFC // brightness (see Sparkfun doc).
#define MAGENTA	0xE3
#define TEAL	0x1F
#define WHITE	0xFF
#define BLACK	0x00

byte frame[16]; // Global frame for display. [0-7] is front frame. [8-15] is buffer frame.
byte color_tst_tbl[] = {
  MAGENTA,MAGENTA,ORANGE,ORANGE,ORANGE,WHITE,WHITE,WHITE,
  MAGENTA,MAGENTA,MAGENTA,ORANGE,ORANGE,ORANGE,WHITE,WHITE,
  RED,MAGENTA,MAGENTA,MAGENTA,ORANGE,ORANGE,ORANGE,WHITE,
  RED,RED,MAGENTA,MAGENTA,ORANGE,ORANGE,ORANGE,ORANGE,
  RED,RED,MAGENTA,MAGENTA,MAGENTA,MAGENTA,ORANGE,ORANGE,
  RED,RED,MAGENTA,MAGENTA,MAGENTA,MAGENTA,MAGENTA,ORANGE,
  RED,RED,RED,RED,RED,MAGENTA,MAGENTA,MAGENTA,
  RED,RED,RED,RED,RED,RED,MAGENTA,MAGENTA,
}; // Table of color codes, one color duplicated to get 8 entries for test purpose.

byte pattern[] = {
  0x00, 0x00, 0x00, 0x00, 0x00, 0x00, 0x00, 0x00, //0:Blank
  0x18, 0x3C, 0x66, 0x66, 0x7E, 0x66, 0x66, 0x00, //1:A
  0x7C, 0x66, 0x66, 0x7C, 0x66, 0x66, 0x7C, 0x00, //2:B
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  0xFE, 0x06, 0x0C, 0x18, 0x30, 0x60, 0xFE, 0x00 //26:Z
};

void showAlphabet(char letter)
{
  if( letter > 64 && letter < 91)
  {
    int alphabet = (letter - 64)*8;
    int index = 0;
    digitalWrite(CHIPSELECT,LOW); // enable the ChipSelect on the backpack
    delayMicroseconds(500);
    for (int i=0;i<8;i++)
    {
	for (int j=0;j<8;j++)
	{
	  if (bitRead(pattern[alphabet+i],j) == 0) //bitRead funcion is used to get each 8 bit of the 8 bytes pattern table (64 bits in total).
	  {
	    SPI.transfer(BLACK);
	  }	 // bit is 0 -> Transfer Black color.
	  else
	  {
	    SPI.transfer(color_tst_tbl[index]);
	  } // bit is 1 -> Transfer a color choosen in the color test table.
	  index++;
	}
    }   // 64 bytes should have been transfered to the RGB matrix.
    digitalWrite(CHIPSELECT,HIGH); // disable the ChipSelect on the backpack
    // What you've send is displayed on the matrix.
    delayMicroseconds(500);
  }
}


void setup()
{
  pinMode(DATAOUT,OUTPUT);
  pinMode(SPICLOCK,OUTPUT);
  pinMode(CHIPSELECT,OUTPUT);
  digitalWrite(CHIPSELECT,HIGH); //disable device

  /*
  SPCR bits:
   7: SPIEE - enables SPI interrupt when high
   6: SPE - enable SPI bus when high
   5: DORD - LSB first when high, MSB first when low
   4: MSTR - arduino is in master mode when high, slave when low
   3: CPOL - data clock idle when high if 1, idle when low if 0
   2: CPHA - data on falling edge of clock when high, rising edge when low
   1: SPR1 - set speed of SPI bus
   0: SPR0 - set speed of SPI bus
   */
   SPI.begin();
}

char incoming_letter;

void loop()
{
  
  char hw[]= "HELLOWORLD";
  for (int i=0;i<10;i++)
  {
    showAlphabet(hw[i]);
    delay(500);
  }
  
}
 

